## arch/arm64/configs/audience_defconfig
```kconfig
#
# Audience earSmart codecs
#
CONFIG_SND_SOC_ES705=y
CONFIG_SND_SOC_ES_I2C=y
# CONFIG_SND_SOC_ESXXX_UPDATE_VEQ_TABLE is not set
# CONFIG_SND_SOC_ESXXX_RESTORE_STD_FW is not set
```

## arch/arm64/configs/cdma_defconfig
```kconfig
#
# CDMA QMUX MODEL
#
CONFIG_MSM_HSIC_SYSMON=y
# CONFIG_MSM_HSIC_SYSMON_TEST is not set
CONFIG_MSM_SUBSYSTEM_RESTART=y
CONFIG_MSM_SYSMON_COMM=y
CONFIG_PCI_EXYNOS_REDUCE_RESET_WAIT=y
CONFIG_RMNET_DATA=y
# CONFIG_RMNET_DATA_FC is not set
CONFIG_RMNET_DATA_DEBUG_PKT=y
# CONFIG_IPC_ROUTER_SECURITY is not set
# CONFIG_SEC_MODEM_V1 is not set
# CONFIG_LINK_DEVICE_SPI is not set
# CONFIG_LINK_DEVICE_MEMORY is not set
# CONFIG_LINK_POWER_MANAGEMENT is not set
# CONFIG_LINK_POWER_MANAGEMENT_WITH_FSM is not set
# CONFIG_LINK_CONTROL_MSG_COMMAND is not set
# CONFIG_LINK_DEVICE_WITH_SBD_ARCH is not set
# CONFIG_LINK_DEVICE_LLI is not set
# CONFIG_UMTS_MODEM_SS333 is not set
CONFIG_FM_RADIO=y
CONFIG_FM_SI4705=y
# CONFIG_DIAGFWD_BRIDGE_CODE is not set
CONFIG_SND_SOC_ES705=y
CONFIG_SND_SOC_ES_I2C=y
CONFIG_SND_SOC_ESXXX_VEQ_EXTENDEDVOLUME=y
CONFIG_USB_EHCI_HCD=y
# CONFIG_USB_EHCI_ROOT_HUB_TT is not set
CONFIG_USB_EHCI_TT_NEWSCHED=y
CONFIG_USB_EHCI_PCI=y
CONFIG_USB_EHCI_S5P=y
# CONFIG_USB_EHCI_HCD_PLATFORM is not set
CONFIG_USB_SERIAL_CSVT=y
# CONFIG_USB_EXYNOS_SWITCH is not set
CONFIG_USB_QCOM_DIAG_BRIDGE=y
# CONFIG_USB_QCOM_DIAG_BRIDGE_TEST is not set
CONFIG_USB_QCOM_MDM_BRIDGE=y
CONFIG_USB_QCOM_KS_BRIDGE=y
CONFIG_USB_QCOM_IPC_BRIDGE=y
CONFIG_SAMSUNG_USB2PHY=y
# CONFIG_SAMSUNG_DWC_USB2PHY is not set
CONFIG_SAMSUNG_USB2PHY_CAL=y
# CONFIG_SWITCH_ANTENNA_EARJACK is not set
CONFIG_SWITCH_ANTENNA_EARJACK_IF=y
# CONFIG_ESOC_DEV is not set
# CONFIG_ESOC_CLIENT is not set
# CONFIG_ESOC_DEBUG is not set
# CONFIG_ESOC_MDM_4x is not set
# CONFIG_ESOC_MDM_DRV is not set
# CONFIG_MDM_HSIC_PM is not set
# CONFIG_MHI=y
# CONFIG_MHI_RMNET_DUMP=y
//CONFIG_SENSORS_SSP_STM=y
//CONFIG_SENSORS_SSP_ATUC128L5HAR=y
//CONFIG_SENSORS_SSP_BMP280=y
//CONFIG_SENSORS_SSP_AK09911=y
//# CONFIG_SENSORS_SSP_LPS25H is not set
//# CONFIG_SENSORS_SSP_BBD is not set
//# CONFIG_SENSORS_SSP_YAS537 is not set
//# CONFIG_SENSORS_SSP_SX9306 is not set
# CONFIG_GPS_BCMxxxxx is not set
# CONFIG_GPS_BCM47531 is not set
CONFIG_MSM_IPC_ROUTER_HSIC_XPRT=y
CONFIG_MSM_QMI_INTERFACE=y
CONFIG_QMI_ENCDEC=y
```

## arch/arm64/configs/helios_defconfig
```kconfig
#
#
# Helios defconfig
#
CONFIG_MORO_SOUND=y
CONFIG_LEDS_MAX77833_RGB_CONTROL=y
CONFIG_LEDS_MAX77843_RGB_CONTROL=y
CONFIG_SSRM_CAMERA_INFO=y
CONFIG_BOEFFLA_WL_BLOCKER=y
CONFIG_POWERSUSPEND=y
# CONFIG_POWERSUSPEND_DEBUG is not set
CONFIG_DYNAMIC_FSYNC=y
CONFIG_LCD_DOZE_MODE=y
CONFIG_STATE_NOTIFIER=y
# CONFIG_PM_SYNC_BEFORE_SUSPEND is not set
CONFIG_WIREGUARD=y
# CONFIG_WIREGUARD_DEBUG is not set
# CONFIG_EXYNOS5_DYNAMIC_CPU_HOTPLUG is not set
# CONFIG_EXYNOS5_DYNAMIC_CPU_HOTPLUG_SLEEP_PREPARE is not set
# CONFIG_PM_WAKELOCKS_GC is not set
# CONFIG_PM_DEBUG is not set
# CONFIG_PM_ADVANCED_DEBUG is not set
# CONFIG_PM_SLEEP_DEBUG is not set
# CONFIG_EXYNOS_APM_VOLTAGE_DEBUG is not set
# CONFIG_TIMA_LOG is not set
# CONFIG_DM_VERITY is not set
CONFIG_INPUT_JOYSTICK=y
# CONFIG_JOYSTICK_ANALOG is not set
# CONFIG_JOYSTICK_A3D is not set
# CONFIG_JOYSTICK_ADI is not set
# CONFIG_JOYSTICK_COBRA is not set
# CONFIG_JOYSTICK_GF2K is not set
# CONFIG_JOYSTICK_GRIP is not set
# CONFIG_JOYSTICK_GRIP_MP is not set
# CONFIG_JOYSTICK_GUILLEMOT is not set
# CONFIG_JOYSTICK_INTERACT is not set
# CONFIG_JOYSTICK_SIDEWINDER is not set
# CONFIG_JOYSTICK_TMDC is not set
# CONFIG_JOYSTICK_IFORCE is not set
# CONFIG_JOYSTICK_WARRIOR is not set
# CONFIG_JOYSTICK_MAGELLAN is not set
# CONFIG_JOYSTICK_SPACEORB is not set
# CONFIG_JOYSTICK_SPACEBALL is not set
# CONFIG_JOYSTICK_STINGER is not set
# CONFIG_JOYSTICK_TWIDJOY is not set
# CONFIG_JOYSTICK_ZHENHUA is not set
# CONFIG_JOYSTICK_AS5011 is not set
# CONFIG_JOYSTICK_JOYDUMP is not set
CONFIG_JOYSTICK_XPAD=y
CONFIG_JOYSTICK_XPAD_FF=y
CONFIG_JOYSTICK_XPAD_LEDS=y
# CONFIG_USB_DEBUG is not set
# CONFIG_USB_DEBUG_DETAILED_LOG is not set
# CONFIG_SEC_AVC_LOG is not set
# CONFIG_SEC_DEBUG_TSP_LOG is not set
# CONFIG_SEC_DEBUG_TIMA_LOG is not set
# CONFIG_SEC_PM_DEBUG is not set
CONFIG_NTFS_FS=m
# CONFIG_NTFS_DEBUG is not set
CONFIG_NTFS_RW=y
# CONFIG_PROC_STLOG is not set
# CONFIG_DEBUG_BUGVERBOSE is not set
# CONFIG_NOP_TRACER is not set
# CONFIG_TRACE_CLOCK is not set
# CONFIG_RING_BUFFER is not set
# CONFIG_EVENT_TRACING is not set
# CONFIG_GPU_TRACEPOINTS is not set
# CONFIG_CONTEXT_SWITCH_TRACER is not set
# CONFIG_TRACING is not set
# CONFIG_FTRACE is not set
CONFIG_CRYPTO_LZ4=y
CONFIG_CRYPTO_LZ4HC=y
CONFIG_LZ4_COMPRESS=y
CONFIG_LZ4HC_COMPRESS=y
CONFIG_LZ4_DECOMPRESS=y
CONFIG_TOUCHSCREEN_DOUBLETAP2WAKE=y
CONFIG_TOUCHSCREEN_PREVENT_SLEEP=y
CONFIG_FRANDOM=y
CONFIG_BATTERY_CONTROL=y
# CONFIG_CC_OPTIMIZE_FOR_SIZE is not set
```

## arch/arm64/configs/intl_defconfig
```kconfig
#
# Audience earSmart codecs
#
# CONFIG_SND_SOC_ES705 is not set
# CONFIG_SND_SOC_ES_I2C is not set
# CONFIG_SND_SOC_ESXXX_UPDATE_VEQ_TABLE is not set
```
